## boards/boardsource/blecorne/Kconfig.defconfig
```kconfig
#
# Copyright (c) 2024 Kyle Brown
# SPDX-License-Identifier: MIT
#

if BOARD_BLECORNE_LEFT

config ZMK_KEYBOARD_NAME
    default "BLE Corne"

config ZMK_SPLIT_ROLE_CENTRAL
    default y

endif # BOARD_BLECORNE_LEFT


if BOARD_BLECORNE_LEFT || BOARD_BLECORNE_RIGHT

config BOARD
    default "blecorne"

config ZMK_SPLIT
    default y

config BT_CTLR
    default BT

if USB

config USB_NRFX
    default y

config USB_DEVICE_STACK
    default y

endif # USB

config ZMK_DISPLAY
    select LV_USE_CONT
    select LV_FONT_MONTSERRAT_26
    select LV_FONT_MONTSERRAT_16
    select LV_USE_LABEL
    select LV_USE_IMG

if ZMK_DISPLAY

config SPI
    default y


config ZMK_DISPLAY_BLANK_ON_IDLE
    default n


endif # ZMK_DISPLAY

endif # BOARD_BLECORNE_LEFT || BOARD_BLECORNE_RIGHT
```

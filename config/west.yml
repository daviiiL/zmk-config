## config/west.yml
```yaml
manifest:
  defaults:
    revision: v0.3
    # revision: main
  remotes:
    - name: zmkfirmware
      url-base: https://github.com/zmkfirmware
    - name: M165437
      url-base: https://github.com/M165437
    - name: mctechnology17
      url-base: https://github.com/mctechnology17
    - name: daviiiL
      url-base: https://github.com/daviiiL
    # Additional modules containing boards/shields/custom code can be listed here as well
    # See https://docs.zephyrproject.org/3.2.0/develop/west/manifest.html#projects
  projects:
    - name: zmk
      remote: zmkfirmware
      import: app/west.yml
    - name: nice-view-gem
      remote: M165437
      revision: 7794ebf
    - name: zmk-nice-oled
      remote: daviiiL
      revision: main
  self:
    path: config
```
